## meta-c444-bgn/conf/layer.conf
```bitbake
# We have a conf and classes directory, add to BBPATH
BBPATH .= ":${LAYERDIR}"

# We have recipes-* directories, add to BBFILES
BBFILES += "${LAYERDIR}/recipes-*/*/*.bb \
            ${LAYERDIR}/recipes-*/*/*.bbappend"

BBFILE_COLLECTIONS += "meta-c444-bgn"
BBFILE_PATTERN_meta-c444-bgn = "^${LAYERDIR}/"

# This needs to be higher priority than meta-mender-c444
BBFILE_PRIORITY_meta-c444-bgn = "13"

# Install mke2fs for creating ext4 filesystems
IMAGE_INSTALL += "e2fsprogs-mke2fs"
# userspace packages for dm-crypt
IMAGE_INSTALL += "libgcc"
IMAGE_INSTALL += "udev"
IMAGE_INSTALL += "lvm2"
IMAGE_INSTALL += "cryptodev-module"
IMAGE_INSTALL += "cryptsetup"
# Adding init script for cryptsetup
IMAGE_INSTALL += "sys-setup"

LAYERDEPENDS_meta-c444-bgn = "core"
LAYERSERIES_COMPAT_meta-c444-bgn = "zeus"
```

## meta-c444-jas/conf/layer.conf
```bitbake
# We have a conf and classes directory, add to BBPATH
BBPATH .= ":${LAYERDIR}"

# We have recipes-* directories, add to BBFILES
BBFILES += "${LAYERDIR}/recipes-*/*/*.bb \
            ${LAYERDIR}/recipes-*/*/*.bbappend"

BBFILE_COLLECTIONS += "meta-c444-jas"
BBFILE_PATTERN_meta-c444-jas = "^${LAYERDIR}/"

# This needs to be higher priority than meta-mender-c444
BBFILE_PRIORITY_meta-c444-jas = "13"

# Install mke2fs for creating ext4 filesystems
IMAGE_INSTALL += "e2fsprogs-mke2fs"
# userspace packages for dm-crypt
IMAGE_INSTALL += "libgcc"
IMAGE_INSTALL += "udev"
IMAGE_INSTALL += "lvm2"
IMAGE_INSTALL += "cryptodev-module"
IMAGE_INSTALL += "cryptsetup"
# Adding init script for cryptsetup
IMAGE_INSTALL += "sys-setup"

LAYERDEPENDS_meta-c444-jas = "core"
LAYERSERIES_COMPAT_meta-c444-jas = "zeus"
```

## meta-essa-c444/conf/layer.conf
```bitbake
# Copyright (c) 2021 BG Networks, Inc.
#
# This program is free software; you can redistribute it and/or modify
# it under the terms of the GNU General Public License as published by
# the Free Software Foundation; either version 2 of the License, or
# (at your option) any later version.
#

# We have a conf and classes directory, add to BBPATH
BBPATH .= ":${LAYERDIR}"

# We have recipes-* directories, add to BBFILES
BBFILES += "${LAYERDIR}/recipes-*/*/*.bb \
            ${LAYERDIR}/recipes-*/*/*.bbappend"

BBFILE_COLLECTIONS += "meta-essa-c444"
BBFILE_PATTERN_meta-essa-c444 = "^${LAYERDIR}/"

# This needs to be higher priority than meta-mender-c444
BBFILE_PRIORITY_meta-essa-c444 = "13"

# userspace packages for dm-crypt
# Don't use += (creates weird issues) and use _append =
IMAGE_INSTALL_append = " libgcc"
IMAGE_INSTALL_append = " udev"
IMAGE_INSTALL_append = " lvm2"
IMAGE_INSTALL_append = " e2fsprogs-mke2fs"
IMAGE_INSTALL_append = " coreutils"
IMAGE_INSTALL_append = " keyutils"
IMAGE_INSTALL_append = " util-linux"
IMAGE_INSTALL_append = " cryptodev-module"
IMAGE_INSTALL_append = " cryptsetup"
# Adding init script for cryptsetup
IMAGE_INSTALL_append = " sys-setup"
IMAGE_INSTALL_append = " caam-keygen"

LAYERDEPENDS_meta-essa-c444 = "core"
LAYERSERIES_COMPAT_meta-essa-c444 = "zeus"
```

## meta-mender-c444/conf/layer.conf
```bitbake
# Copyright (c) 2021 BG Networks, Inc.
#
# This program is free software; you can redistribute it and/or modify
# it under the terms of the GNU General Public License as published by
# the Free Software Foundation; either version 2 of the License, or
# (at your option) any later version.
#

# We have a conf and classes directory, add to BBPATH
BBPATH .= ":${LAYERDIR}"

# We have a packages directory, add to BBFILES
BBFILES += "${LAYERDIR}/recipes-*/*/*.bb \
            ${LAYERDIR}/recipes-*/*/*.bbappend"

BBFILE_COLLECTIONS += "mender-c444"
BBFILE_PATTERN_mender-c444 := "^${LAYERDIR}"
LAYERSERIES_COMPAT_mender-c444 = "zeus"

# This needs to be higher priority than meta-imx
# We have to override the do_compile() function it provides for our newer
# u-boot version.
BBFILE_PRIORITY_mender-c444 = "11"

LAYERDEPENDS_mender-c444 = "mender freescale-layer fsl-bsp-release"
```
